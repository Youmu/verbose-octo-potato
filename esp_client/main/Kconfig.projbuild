## esp_client/main/Kconfig.projbuild
```kconfig
menu "ESP Potato Client Configuration"

    config POTATO_WIFI_SSID
        string "Wifi SSID"
        default "TooYoung"
        help
            "Your Wifi SSID"

    config POTATO_WIFI_PASSWORD
        string "Wifi Password"
        default "glgjssy-qyfhbqz"
        help
            "Your Wifi Password"

    config POTATO_SERVER_EP
        string "Potato Server Endpoint"
        default "https://www.example.com/potato/msg"
        help
            Potato Server Endpoint.

    config POTATO_SERVER_AUTHTOKEN
        string "Auth Token of the server EP"
        default "Hello-World!"
        help
            You should know where to find it.

    config POTATO_MSG_ENCRYPT_KEY
        string "The message encryption key"
        default "AAAAAAAAAAAAAAAAAAAAAAAAAAAAAAAAAAAAAAAAAAA="
        help
            An AES-256 encryptino key, Base64 encoded.

    config POTATO_PIN_I2C_SDA
        int "RTC Controller I2C SDA Pin"
        default 20
        help
            The GPIO number of I2C SDA Pin

    config POTATO_PIN_I2C_SCL
        int "RTC Controller I2C SCL Pin"
        default 19
        help
            The GPIO number of I2C SDA Pin

    config POTATO_PIN_UART_TX
        int "UART TX Ping"
        default 10
        help
            The GPIO number of TX pin of UART 1

    config POTATO_PIN_UART_RX
        int "UART RX Ping"
        default 11
        help
            The GPIO number of RX pin of UART 1


endmenu
```
